## Kconfig
```kconfig
config ZMK_INPUT_PROCESSOR_SIGMOID_ACCEL
    bool "Enable maccel acceleration input processor"
    default y
    depends on ZMK_POINTING
    help
      Enable the maccel-style pointer acceleration input processor.
      Applies the burkfers/Wimads acceleration curve so slow movements
      are reduced (precise) and fast movements approach full hardware CPI.
```

## dts/bindings/input/zmk,input-processor-sigmoid-accel.yaml
```yaml
description: |
  maccel-style pointer acceleration input processor.
  Applies the burkfers/Wimads acceleration curve:
    f(v) = upper - (upper - limit) / (1 + exp(takeoff*(v-offset)))^(growth_rate/takeoff)

  At slow speeds the factor approaches `limit` (< 1.0 = reduces reported CPI).
  At fast speeds it approaches `limit-upper` (1.0 = full hardware CPI).

  The `cpi` property must match the hardware sensor CPI so velocity is normalized
  consistently across different CPI settings.

  Example:
    &sigmoid_accel {
        cpi = <3200>;
        takeoff = <200>;      // 2.0
        growth-rate = <25>;   // 0.25
        offset = <220>;       // 2.20
        limit = <20>;         // 0.20 - slow movements at 20% speed
        limit-upper = <100>;  // 1.00 - fast movements at full speed
    };

compatible: "zmk,input-processor-sigmoid-accel"

include: base.yaml

properties:
  "#input-processor-cells":
    type: int
    required: true
    const: 0

  track-remainders:
    type: boolean
    description: Processor handles sub-pixel carry internally.

  cpi:
    type: int
    required: true
    description: |
      Hardware sensor CPI. Used to normalize velocity so the acceleration
      parameters are independent of the sensor resolution.

  takeoff:
    type: int
    default: 200
    description: |
      Controls how sharply the curve takes off (k), divided by 100.
      Higher = more abrupt start. 200 = k of 2.0.

  growth-rate:
    type: int
    default: 25
    description: |
      How quickly the curve reaches its upper limit (g), divided by 100.
      Lower = flatter curve. 25 = g of 0.25.

  offset:
    type: int
    default: 220
    description: |
      Velocity at which acceleration kicks in (s), divided by 100.
      Higher = acceleration starts later (more low-speed precision).
      220 = s of 2.20.

  limit:
    type: int
    default: 20
    description: |
      Lower limit of the acceleration factor (m), divided by 100.
      This is the factor applied to slow movements.
      20 = 0.20x (slow movements at 20% of hardware CPI).

  limit-upper:
    type: int
    default: 100
    description: |
      Upper limit of the acceleration factor, divided by 100.
      100 = 1.00x (fast movements at full hardware CPI).
```
