/*
 * maccel acceleration input processor instance.
 *
 * Include this file to get a pre-configured maccel processor node.
 * Then add &sigmoid_accel to your input-processors chain.
 *
 * The `cpi` property MUST match your hardware sensor CPI. Override it in
 * your overlay. Other properties can be left at defaults or tuned.
 *
 * Example (in your overlay):
 *   #include <behaviors/input_processor_sigmoid_accel.dtsi>
 *
 *   &trackball_listener {
 *       input-processors = <&zip_zxy>, <&sigmoid_accel>;
 *   };
 *
 *   &sigmoid_accel {
 *       cpi = <3200>;
 *   };
 */

/ {
    input_processors {
        compatible = "zmk,input-processors";

        sigmoid_accel: sigmoid_accel {
            compatible = "zmk,input-processor-sigmoid-accel";
            #input-processor-cells = <0>;
            track-remainders;

            /*
             * CPI must be overridden to match your sensor. There is no
             * universal default since it depends on hardware configuration.
             */
            cpi = <800>;

            /* Default curve parameters (matching zmk-pmw3610-driver maccel defaults) */
            takeoff = <200>;      /* k = 2.0  — how sharply the curve takes off */
            growth-rate = <25>;   /* g = 0.25 — how fast it reaches the upper limit */
            offset = <220>;       /* s = 2.20 — velocity where acceleration kicks in */
            limit = <20>;         /* m = 0.20 — minimum factor (slow speed) */
            limit-upper = <100>;  /* upper = 1.00 — maximum factor (fast speed) */
        };
    };
};
